## custom_board_def/Config.in
```kconfig
source "$BR2_EXTERNAL_UCL_STM32_PATH/package/yanncharbon/at86rf215/Config.in"
source "$BR2_EXTERNAL_UCL_STM32_PATH/package/yanncharbon/at86rf215icp/Config.in"
#source "$BR2_EXTERNAL_<NAME>_PATH/package/package2/Config.in"
```

## custom_board_def/package/yanncharbon/at86rf215icp/Config.in
```kconfig
config BR2_PACKAGE_AT86RF215ICP
	bool "at86rf215icp"
	depends on BR2_LINUX_KERNEL
	#depends on SPI_MASTER
	#select REGMAP_SPI
	help
		Driver for AT86RF215 transceiver supporting IEEE 802.15.4g (driver from Icecreampint)
```
